## package/Config.in
```kconfig
config BR2_PACKAGE_MMDVMHOST
	bool "MMDVMHost"
	help
		MMDVMHost

config BR2_PACKAGE_DMRGATEWAY
	bool "DMRGateway"
	help
		DMRGateway

config BR2_PACKAGE_DAPNETGATEWAY
	bool "DAPNETGateway"
	help
		DAPNETGateway

config BR2_PACKAGE_MMDVMCAL
	bool "MMDVMCal"
	help
		MMDVMCal
```
